## build/conf/bblayers.conf
```bitbake
# POKY_BBLAYERS_CONF_VERSION is increased each time build/conf/bblayers.conf
# changes incompatibly
POKY_BBLAYERS_CONF_VERSION = "2"

BBPATH = "${TOPDIR}"
BBFILES ?= ""

BBLAYERS ?= " \
  /home/yocto/poky/meta \
  /home/yocto/poky/meta-poky \
  /home/yocto/poky/meta-yocto-bsp \
  /home/yocto/poky/meta-ti \
  /home/yocto/poky/meta-openembedded/meta-oe \
  /home/yocto/poky/meta-openembedded/meta-networking \
  /home/yocto/poky/meta-openembedded/meta-python \
  /home/yocto/poky/meta-arm/meta-arm \
  /home/yocto/poky/meta-arm/meta-arm-bsp \
  /home/yocto/poky/meta-arm/meta-arm-toolchain \
"
```

## build/conf/local.conf
```bitbake
# Target machine
MACHINE ?= "am335x-evm" 

TUNE_FEATURES ?= "arm armv7a vfp neon"

PACKAGE_ARCHS_append = " armv7a-neon"

# set the endpoint for network checks
CONNECTIVITY_CHECK_URIS = "https://www.example.com/"

# Path to the local uninative tarball
UNINATIVE_TARBALL = "/home/yocto/poky/uninative/x86_64-nativesdk-libc-4.4.tar.xz"

# disable network checks
# BB_NO_NETWORK = "1"

# Default policy config
DISTRO ?= "poky"

# Package Management configuration
PACKAGE_CLASSES ?= "package_deb package_rpm"

# Extra image configuration defaults
EXTRA_IMAGE_FEATURES ?= "debug-tweaks tools-sdk tools-debug"

IMAGE_INSTALL:append = " openssh-sftp-server"

# Where to place downloads
DL_DIR ?= "${TOPDIR}/downloads"

# Where to place shared-state files
SSTATE_DIR ?= "${TOPDIR}/sstate-cache"

# Where to place the build output
TMPDIR = "${TOPDIR}/tmp"

# SDK target architecture
#SDKMACHINE ?= "i686"

# Disk Space Monitoring during the build
BB_DISKMON_DIRS ??= "\
    STOPTASKS,${TMPDIR},1G,100K \
    STOPTASKS,${DL_DIR},1G,100K \
    STOPTASKS,${SSTATE_DIR},1G,100K \
    STOPTASKS,/tmp,100M,100K \
    ABORT,${TMPDIR},100M,1K \
    ABORT,${DL_DIR},100M,1K \
    ABORT,${SSTATE_DIR},100M,1K \
    ABORT,/tmp,10M,1K"

# Additional classes to use during the build
USER_CLASSES ?= "buildstats" 

# Interactive shell configuration
PATCHRESOLVE = "noop"

# Qemu configuration
PACKAGECONFIG:append:pn-qemu-system-native = " sdl"

# Configuration file version
CONF_VERSION = "1"

# Runtime testing of images
#IMAGE_CLASSES += "testimage testsdk"
#TESTIMAGE_AUTO:qemuall = "1"
```
